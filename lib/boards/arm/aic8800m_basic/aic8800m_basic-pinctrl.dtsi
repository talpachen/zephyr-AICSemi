/*
 * Copyright (c) 2022, Talpa Chen
 * SPDX-License-Identifier: Apache-2.0
 */

#include <dt-bindings/pinctrl/aic8800x-pinctrl.h>

&pinctrl {
	uart0_default: uart0_default {
		group1 {
			pinmux = <UART0_TX_PA9>;
		};
		group2 {
			pinmux = <UART0_RX_PA8>;
		};
	};
};

## boards/arm/aic8800m_basic/Kconfig.board
```kconfig
# Copyright (c) 2022, Talpa Chen
# SPDX-License-Identifier: Apache-2.0

config BOARD_AIC8800M_BASIC
	bool "AICSemi AIC8800M Basic Board"
	depends on SOC_AIC8800M
```

## boards/arm/aic8800m_basic/Kconfig.defconfig
```kconfig
# Copyright (c) 2022, Talpa Chen
# SPDX-License-Identifier: Apache-2.0

if BOARD_AIC8800M_BASIC

config BOARD
	default "aic8800m_basic"

endif # BOARD_AIC8800M_BASIC
```

## drivers/gpio/Kconfig.aic8800x
```kconfig
# Copyright (c) 2022, Talpa Chen
# SPDX-License-Identifier: Apache-2.0

config GPIO_AIC8800X
	bool "AICSemi AIC8800X GPIO driver"
	default y
	depends on SOC_SERIES_AIC8800X
	select HAS_DTS_GPIO
	help
	  AICSemi AIC8800X gpio driver
```

## drivers/pinctrl/Kconfig.aic8800x
```kconfig
# Copyright (c) 2022, Talpa Chen
# SPDX-License-Identifier: Apache-2.0

config PINCTRL_AICSEMI_AIC8800X
	bool "AICSemi AIC8800X pin controller driver"
	depends on SOC_SERIES_AIC8800X
	default y
	help
	  AICSemi AIC8800X pin controller driver
```

## drivers/pinmux/Kconfig.aic8800x
```kconfig
# Copyright (c) 2022, Talpa Chen
# SPDX-License-Identifier: Apache-2.0

config PINMUX_AIC8800X
	bool "AICSemi AIC8800X Pinmux driver"
	depends on SOC_SERIES_AIC8800X
	default y
	help
		AICSemi AIC8800X Pinmux driver
```

## drivers/serial/Kconfig.aic8800x
```kconfig
# Copyright (c) 2022, Talpa Chen
# SPDX-License-Identifier: Apache-2.0

config UART_AIC8800X
	bool "AICSemi AIC8800X serial driver"
	depends on SOC_SERIES_AIC8800X
	select SERIAL_HAS_DRIVER
	help
	  AICSemi AIC8800X uart driver
```

## drivers/watchdog/Kconfig.aic8800x
```kconfig
# Copyright (c) 2022, Talpa Chen
# SPDX-License-Identifier: Apache-2.0

config WDT_AIC8800X
	bool "AICSemi AIC8800X Watchdog (WDT) driver"
	depends on SOC_SERIES_AIC8800X
	help
	  AICSemi AIC8800X watchdog driver
```

## dts/bindings/pinctrl/aicsemi,aic8800x-pinctrl.yaml
```yaml
# Copyright (c) 2022 Talpa Chen
# SPDX-License-Identifier: Apache-2.0

description: AIC8800X Pinctrl

compatible: "aicsemi,aic8800x-pinctrl"

include:
    - name: base.yaml
    - name: pincfg-node.yaml
      child-binding:
        property-allowlist:
          - bias-disable
          - bias-pull-up
          - bias-pull-down

properties:
    reg:
      required: true

child-binding:
  description: |
    AIC8800X pin controller pin configuration state nodes.
  child-binding:
    description:
      AIC8800X pin controller pin configuration group.
    properties:
      pinmux:
        required: true
        type: array
```

## lib/boards/arm/aic8800m_basic/aic8800m_basic_defconfig
```kconfig
# Copyright (c) 2022, Talpa Chen
# SPDX-License-Identifier: Apache-2.0

CONFIG_SOC_SERIES_AIC8800X=y
CONFIG_SOC_AIC8800M=y
CONFIG_BOARD_AIC8800M_BASIC=y

CONFIG_ARM_MPU=y
CONFIG_HW_STACK_PROTECTION=y
CONFIG_CORTEX_M_SYSTICK=y

CONFIG_CONSOLE=y
CONFIG_UART_CONSOLE=y
CONFIG_SERIAL=y

CONFIG_GPIO=y

CONFIG_BUILD_OUTPUT_BIN=y
```

## lib/drivers/serial/Kconfig.aic8800x
```kconfig
# Copyright (c) 2022, Talpa Chen
# SPDX-License-Identifier: Apache-2.0

DT_COMPAT_AICSEMI_AIC8800X_UART := aicsemi,aic8800x-uart

config USART_AICSEMI_AIC8800X
	bool "AICSemi AIC8800X serial driver"
	depends on SOC_SERIES_AIC8800X
	default $(dt_compat_enabled,$(DT_COMPAT_AICSEMI_AIC8800X_UART))
	select SERIAL_HAS_DRIVER
	help
	  AICSemi AIC8800X uart driver
```

## lib/dts/bindings/serial/aicsemi,aic8800x-uart.yaml
```yaml
# Copyright (c) 2022 Talpa Chen
# SPDX-License-Identifier: Apache-2.0

description: AIC8800X UART

compatible: "aicsemi,aic8800x-uart"

include: [uart-controller.yaml, pinctrl-device.yaml]

properties:
    reg:
      required: true

    interrupts:
      required: false

    clocks:
      required: false

    pinctrl-0:
      required: false

    pinctrl-names:
      required: false
```

## lib/soc/arm/aicsemi/Kconfig
```kconfig
# Copyright (c) 2022, Talpa Chen
# SPDX-License-Identifier: Apache-2.0

config SOC_FAMILY_AICSEMI
	bool

if SOC_FAMILY_AICSEMI

config SOC_FAMILY
	string
	default "aicsemi"

source "soc/arm/aicsemi/*/Kconfig.soc"

endif # SOC_FAMILY_AICSEMI
```

## lib/soc/arm/aicsemi/Kconfig.defconfig
```kconfig
# Copyright (c) 2022, Talpa Chen
# SPDX-License-Identifier: Apache-2.0

if SOC_FAMILY_AICSEMI

source "soc/arm/aicsemi/*/Kconfig.defconfig.series"

endif # SOC_FAMILY_AICSEMI
```

## lib/soc/arm/aicsemi/aic8800x/Kconfig.defconfig.aic8800m
```kconfig
# Copyright (c) 2022, Talpa Chen
# SPDX-License-Identifier: Apache-2.0

config SOC
	default "aic8800m"
```

## lib/soc/arm/aicsemi/aic8800x/Kconfig.soc
```kconfig
# Copyright (c) 2022, Talpa Chen
# SPDX-License-Identifier: Apache-2.0

choice
	prompt "AICSemi AIC8800X SOC Selection"
	depends on SOC_SERIES_AIC8800X

	config SOC_AIC8800M
		bool "aic8800m"

endchoice
```

## soc/arm/aicsemi/Kconfig.soc
```kconfig
# Copyright (c) 2022, Talpa Chen
# SPDX-License-Identifier: Apache-2.0

source "soc/arm/aicsemi/*/Kconfig.series"
```

## soc/arm/aicsemi/aic8800x/Kconfig.defconfig.series
```kconfig
# Copyright (c) 2022, Talpa Chen
# SPDX-License-Identifier: Apache-2.0

if SOC_SERIES_AIC8800X

source "soc/arm/aicsemi/aic8800/Kconfig.defconfig.aic8800*"

config SOC_SERIES
	default "aic8800x"

config SYS_CLOCK_HW_CYCLES_PER_SEC
       default $(dt_node_int_prop_int,/cpus/cpu@0,clock-frequency)

config NUM_IRQS
	default 96

endif # SOC_SERIES_AIC8800X
```

## soc/arm/aicsemi/aic8800x/Kconfig.series
```kconfig
# Copyright (c) 2022, Talpa Chen
# SPDX-License-Identifier: Apache-2.0

config SOC_SERIES_AIC8800X
	bool "AICSemi AIC8800X series Wifi6 and Bluetooth 5.0 SOC"
	select ARM
	select CPU_CORTEX_M4
	select CPU_CORTEX_M_HAS_SYSTICK
	select CPU_CORTEX_M_HAS_VTOR
	select CPU_HAS_ARM_MPU
	select CPU_HAS_FPU
	select SOC_FAMILY_AICSEMI
	help
	  Enable support for AICSemi AIC8800X SOC series
```

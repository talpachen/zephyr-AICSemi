/*
 * Copyright (c) 2022, Talpa Chen
 * SPDX-License-Identifier: Apache-2.0
 */

 #include <dt-bindings/pinctrl/aic8800x-pinctrl.h>

&pinctrl_a {
	uart0_default: uart0_default {
		group1 {
			pinmux = <UART0_RX_A8>,
				<UART0_TX_A9>;
		};
	};
};
